/* Тот же скрипт, что в первой статье, с ОДНИМ отличием: .rodata кладётся
   по явному адресу 0x80001000, а не сразу за кодом.

   Зачем он нужен. Опыт `make where` берёт ОДИН И ТОТ ЖЕ объектный файл и
   ссылает его дважды, этим скриптом и обычным. Объектный файл при этом не
   пересобирается, его контрольная сумма печатается для доказательства.
   Меняется ровно одна вещь: куда компоновщику велено положить строку.

   Если после этого байты инструкций `la` разные, значит ассемблер их знать
   не мог, и дописал их кто-то другой. */

OUTPUT_ARCH(riscv)
ENTRY(_start)

MEMORY
{
    RAM (rwx) : ORIGIN = 0x80000000, LENGTH = 128M
}

SECTIONS
{
    .text : {
        *(.text)
        *(.text.*)
    } > RAM

    .rodata 0x80001000 : {
        *(.rodata)
        *(.rodata.*)
    }
}
